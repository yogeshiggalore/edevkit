## CMakeLists.txt
```
cmake_minimum_required(VERSION 3.20.0)
find_package(Zephyr REQUIRED HINTS $ENV{ZEPHYR_BASE})
project(usb_01)

target_sources(app PRIVATE 
    src/main.c
    src/hello_enum.c
)
```

## prj.conf
```kconfig
CONFIG_USB_DEVICE_STACK_NEXT=y

CONFIG_LOG=y
CONFIG_USE_SEGGER_RTT=y
CONFIG_RTT_CONSOLE=y
CONFIG_UART_CONSOLE=n

CONFIG_USBD_LOG_LEVEL_INF=y

CONFIG_HEAP_MEM_POOL_SIZE=2048

CONFIG_THREAD_NAME=y
CONFIG_BOOT_BANNER=y
```

## boards/rpi_pico2_rp2350a_m33.overlay
```dts
  /{
    chosen {
        zephyr,uart-mcumgr = &usbd;
    };                                                                                                                                                                                                             
};                         

&usbd {
    status = "okay";
};
```

## src/main.c
```c
#include <zephyr/kernel.h>
#include <zephyr/usb/usbd.h>
#include <zephyr/logging/log.h>

LOG_MODULE_REGISTER(usb_01, LOG_LEVEL_INF);

USBD_DESC_LANG_DEFINE(lang);
USBD_DESC_MANUFACTURER_DEFINE(mfr, "edevkit");
USBD_DESC_PRODUCT_DEFINE(product, "usb_01");
USBD_DESC_SERIAL_NUMBER_DEFINE(serial);

/*
 * USB_SCD_REMOTE_WAKEUP = bit 5 of bmAttributes
 * 50 (decimal) = 100 mA in 2-mA units
 * Last argument is an optional configuration-string descriptor (NULL = none)
 */
USBD_CONFIGURATION_DEFINE(cfg, USB_SCD_REMOTE_WAKEUP, 50, NULL);

/* idVendor — pid.codes umbrella */
/* idProduct — usb_01 */
USBD_DEVICE_DEFINE(usbd_ctx, DEVICE_DT_GET(DT_NODELABEL(usbd)), 0x1209, 0xede1);

int main(void)
{
	int err;

	/* (1) Add string descriptors to the context.
	 *     Order must match the index slots in the device descriptor.
	 */
	err = usbd_add_descriptor(&usbd_ctx, &lang);
	if (err)
	{
		LOG_ERR("add lang: %d", err);
		return -1;
	}
	err = usbd_add_descriptor(&usbd_ctx, &mfr);
	if (err)
	{
		LOG_ERR("add mfr: %d", err);
		return -1;
	}
	err = usbd_add_descriptor(&usbd_ctx, &product);
	if (err)
	{
		LOG_ERR("add prod: %d", err);
		return -1;
	}
	err = usbd_add_descriptor(&usbd_ctx, &serial);
	if (err)
	{
		LOG_ERR("add ser: %d", err);
		return -1;
	}

	/* (2) Add the configuration to the context, declaring its speed
	 *     (we're FS-only on RP2350).  The macro hidden in step (3) of
	 *     the class file is what attaches the interface to this config.
	 */
	err = usbd_add_configuration(&usbd_ctx, USBD_SPEED_FS, &cfg);
	if (err)
	{
		LOG_ERR("add cfg: %d", err);
		return -1;
	}

	/* (3) Register the no-op vendor class instance into the configuration.
	 *     The string "hello_enum" must match the name passed to
	 *     USBD_DEFINE_CLASS in src/hello_enum.c.
	 */
	err = usbd_register_class(&usbd_ctx, "hello_enum",
							  USBD_SPEED_FS, 1 /* config index */);
	if (err)
	{
		LOG_ERR("register class: %d", err);
		return -1;
	}

	/* (4) Finalize the descriptor tree (validates, links wTotalLength, etc.)
	 */
	err = usbd_init(&usbd_ctx);
	if (err)
	{
		LOG_ERR("usbd_init: %d", err);
		return -1;
	}

	/* (5) Connect the pull-up — from this moment the host can see us.
	 */
	err = usbd_enable(&usbd_ctx);
	if (err)
	{
		LOG_ERR("usbd_enable: %d", err);
		return -1;
	}

	LOG_INF("usb_01 hello_enum: USB enabled, idle");

	/* (6) Nothing for main thread to do.  The USB stack runs in its
	 *     own work queue; events come in via the class callbacks.
	 */
	while (true)
	{
		k_sleep(K_FOREVER);
	}
	return 0;
}
```

## src/hello_enum.c
```c
/*
 * usb_01_hello_enum — minimal vendor class implementation
 * --------------------------------------------------------
 * Exposes ONE interface, ZERO data endpoints, vendor class 0xFF/0xFF/0xFF.
 * The device enumerates and idles; no driver loads on the host side; no
 * data flows.  Total descriptor footprint: 9-byte interface descriptor
 * inside a 9-byte configuration wrapper = wTotalLength of 18.
 *
 * Pairs with USB Book Ch 05 — every byte the host reads here matches the
 * worked example in the chapter.
 */

#include <zephyr/kernel.h>
#include <zephyr/usb/usbd.h>
#include <zephyr/usb/usb_ch9.h>
#include <zephyr/logging/log.h>

LOG_MODULE_REGISTER(hello_enum, LOG_LEVEL_INF);

/* ---------------------------------------------------------------------------
 * Interface descriptor — 9 bytes, vendor-specific, no endpoints.
 * ------------------------------------------------------------------------- */
static struct usb_if_descriptor hello_enum_iface = {
	.bLength = sizeof(struct usb_if_descriptor),
	.bDescriptorType = USB_DESC_INTERFACE, /* 0x04 */
	.bInterfaceNumber = 0,				   /* assigned at init time   */
	.bAlternateSetting = 0,
	.bNumEndpoints = 0,				   /* the whole point         */
	.bInterfaceClass = USB_BCC_VENDOR, /* 0xFF                    */
	.bInterfaceSubClass = 0xFF,
	.bInterfaceProtocol = 0xFF,
	.iInterface = 0, /* no string               */
};

/* ---------------------------------------------------------------------------
 * NULL-terminated array of descriptor pointers — what get_desc returns.
 *
 * The USB-Device-Next core walks this array as `struct usb_desc_header **`,
 * stopping when it sees NULL.  Each entry must be castable to that base
 * struct, so we cast our concrete usb_if_descriptor here.
 * ------------------------------------------------------------------------- */
static struct usb_desc_header *hello_enum_fs_desc[] = {
	(struct usb_desc_header *)&hello_enum_iface,
	NULL,
};

/* ---------------------------------------------------------------------------
 * Class-API callbacks.  Only the four we actually need are populated; the
 * rest of the slots are left NULL and the core handles that.
 * ------------------------------------------------------------------------- */

static int hello_enum_init(struct usbd_class_data *const c_data)
{
	LOG_DBG("hello_enum: init");
	return 0;
}

static void hello_enum_enable(struct usbd_class_data *const c_data)
{
	/* Called when host completes SET_CONFIGURATION(1) — we are now
	 * "configured" in spec parlance.  This is the Ch-05 milestone. */
	LOG_INF("hello_enum: configured (enabled)");
}

static void hello_enum_disable(struct usbd_class_data *const c_data)
{
	/* SET_CONFIGURATION(0) or unplug. */
	LOG_INF("hello_enum: deconfigured (disabled)");
}

static void *hello_enum_get_desc(struct usbd_class_data *const c_data,
								 const enum usbd_speed speed)
{
	if (speed == USBD_SPEED_FS)
	{
		return hello_enum_fs_desc;
	}
	return NULL;
}

/* ---------------------------------------------------------------------------
 * Vtable.  Optional callbacks left as NULL:
 *   feature_halt, update, control_to_dev, control_to_host, request,
 *   suspended, resumed, sof, shutdown
 * The core checks these for NULL before calling.
 * ------------------------------------------------------------------------- */
static const struct usbd_class_api hello_enum_api = {
	.init = hello_enum_init,
	.enable = hello_enum_enable,
	.disable = hello_enum_disable,
	.get_desc = hello_enum_get_desc,
};

/* ---------------------------------------------------------------------------
 * Class registration.
 *
 *   class_name : the string used by main.c's usbd_register_class() call —
 *                must match exactly: "hello_enum".
 *   api        : pointer to the vtable above.
 *   priv       : per-instance private data; we have none.
 *   v_reqs     : vendor-request handler; we have none.
 * ------------------------------------------------------------------------- */
USBD_DEFINE_CLASS(hello_enum, &hello_enum_api, NULL, NULL);
```
