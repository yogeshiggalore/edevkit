## CMakeLists.txt
```
cmake_minimum_required(VERSION 3.20.0)
find_package(Zephyr REQUIRED HINTS $ENV{ZEPHYR_BASE})
project(usb_04)

target_sources(app PRIVATE
    src/main.c
    src/control_demo.c
)
```

## prj.conf
```kconfig
CONFIG_USB_DEVICE_STACK_NEXT=y      # G5 — mandatory for USBD_* macros
CONFIG_HWINFO=y                     # G14 — required for hwinfo_get_device_id()

CONFIG_LOG=y
CONFIG_USE_SEGGER_RTT=y
CONFIG_RTT_CONSOLE=y
CONFIG_UART_CONSOLE=n

CONFIG_USBD_LOG_LEVEL_INF=y

CONFIG_HEAP_MEM_POOL_SIZE=2048

CONFIG_THREAD_NAME=y
CONFIG_BOOT_BANNER=y
```

## boards/rpi_pico2_rp2350a_m33.overlay
```dts
/* G6 — the RP2350 board exposes the UDC node as &usbd. */
&usbd {
    status = "okay";
};
```

## src/main.c
```c
/*
 * usb_04 — control transfers in depth.
 *
 * Boot flow is byte-identical to usb_03 (5 explicit string adds → iface_str
 * idx patch → usbd_add_configuration → register_class → init → enable). The
 * new material is entirely inside control_demo.c, where control_to_host /
 * control_to_dev handle four vendor requests on EP0.
 *
 * See firmware_sample_usb_04.html for the design narrative + byte-level
 * Setup packets + EP0 state machine.
 */

#include <stdio.h>
#include <errno.h>
#include <zephyr/kernel.h>
#include <zephyr/usb/usbd.h>
#include <zephyr/drivers/hwinfo.h>
#include <zephyr/logging/log.h>

LOG_MODULE_REGISTER(usb_04, LOG_LEVEL_INF);

#define DEMO_CLASS_NAME "control_demo"

extern void control_demo_set_iface_idx(uint8_t idx);

/* ===========================================================================
 * Static string descriptors. Order assigns indices (G7, G11).
 * =========================================================================*/

USBD_DESC_LANG_DEFINE(lang_desc);                                          /* G11 */
USBD_DESC_MANUFACTURER_DEFINE(mfr_desc,     "edevkit");
USBD_DESC_PRODUCT_DEFINE     (product_desc, "usb_04 - control_demo");      /* G12: ASCII7 only */
USBD_DESC_CONFIG_DEFINE      (cfg_str,      "Default config");
USBD_DESC_STRING_DEFINE      (iface_str,    "Vendor (control demo, 4 EP0 requests)",
                              USBD_DUT_STRING_INTERFACE);

/* ===========================================================================
 * Custom serial-number string descriptor (G14). Same hand-rolled pattern as
 * usb_03 — writable buffer, populated from hwinfo at boot.
 * =========================================================================*/

#define SERIAL_TEMPLATE   "EDV-0000-0000-0000"
#define SERIAL_BUF_SIZE   sizeof(SERIAL_TEMPLATE)

static char serial_buf[SERIAL_BUF_SIZE] = SERIAL_TEMPLATE;

static struct usbd_desc_node serial_node = {
    .str = {
        .utype  = USBD_DUT_STRING_SERIAL_NUMBER,
        .ascii7 = true,
    },
    .ptr             = serial_buf,
    .bLength         = USB_STRING_DESCRIPTOR_LENGTH(SERIAL_TEMPLATE),
    .bDescriptorType = USB_DESC_STRING,
};

static int serial_init(void)
{
    uint8_t id[8] = {0};
    ssize_t n = hwinfo_get_device_id(id, sizeof(id));

    if (n < 6) {
        LOG_ERR("hwinfo_get_device_id returned %d (need >= 6)", (int)n);
        return -EIO;
    }

    int written = snprintf(serial_buf, sizeof(serial_buf),
                           "EDV-%02X%02X-%02X%02X-%02X%02X",
                           id[0], id[1], id[2], id[3], id[4], id[5]);
    if (written != (int)(sizeof(serial_buf) - 1)) {
        LOG_ERR("serial format truncated (wrote %d, expected %d)",
                written, (int)(sizeof(serial_buf) - 1));
        return -ENOSPC;
    }

    LOG_INF("serial: %s", serial_buf);
    return 0;
}

/* ===========================================================================
 * Configuration. cfg_str auto-registered by usbd_add_configuration() — G15.
 * =========================================================================*/

USBD_CONFIGURATION_DEFINE(cfg, USB_SCD_REMOTE_WAKEUP, 50, &cfg_str);

/* ===========================================================================
 * Device-level identity. PID 0xede4, bcdDevice 0x0104.
 * =========================================================================*/

USBD_DEVICE_DEFINE(usbd_ctx, DEVICE_DT_GET(DT_NODELABEL(usbd)),
                   0x1209, 0xede4);

int main(void)
{
    int err;

    (void)serial_init();

    err = usbd_add_descriptor(&usbd_ctx, &lang_desc);
    if (err) { LOG_ERR("add lang: %d", err);          return -1; }
    err = usbd_add_descriptor(&usbd_ctx, &mfr_desc);
    if (err) { LOG_ERR("add mfr: %d", err);           return -1; }
    err = usbd_add_descriptor(&usbd_ctx, &product_desc);
    if (err) { LOG_ERR("add product: %d", err);       return -1; }
    err = usbd_add_descriptor(&usbd_ctx, &serial_node);
    if (err) { LOG_ERR("add serial: %d", err);        return -1; }
    err = usbd_add_descriptor(&usbd_ctx, &iface_str);
    if (err) { LOG_ERR("add iface_str: %d", err);     return -1; }

    uint8_t iface_idx = usbd_str_desc_get_idx(&iface_str);
    LOG_INF("iface_str registered at idx %u", iface_idx);
    control_demo_set_iface_idx(iface_idx);

    err = usbd_add_configuration(&usbd_ctx, USBD_SPEED_FS, &cfg);
    if (err) { LOG_ERR("add cfg: %d", err); return -1; }

    err = usbd_register_class(&usbd_ctx, DEMO_CLASS_NAME,
                              USBD_SPEED_FS, 1);
    if (err) { LOG_ERR("register class: %d", err); return -1; }

    err = usbd_init(&usbd_ctx);
    if (err) { LOG_ERR("usbd_init: %d", err); return -1; }

    err = usbd_enable(&usbd_ctx);
    if (err) { LOG_ERR("usbd_enable: %d", err); return -1; }

    LOG_INF("usb_04 control_demo: enabled, waiting on EP0 vendor requests");

    while (true) {
        k_sleep(K_FOREVER);
    }
    return 0;
}
```

## src/control_demo.c
```c
/*
 * control_demo — vendor class, 1 interface, 4 vendor control requests on EP0.
 *
 * Wire-shape carry-forward from usb_03: same 1-iface / 2-bulk-EP descriptor
 * tree (the bulk endpoints still NAK forever — bringing them to life lands in
 * a future "endpoint buffers" sample). The new material is on EP0 only.
 *
 * Vendor requests (bmRequestType.type = VENDOR, recipient = INTERFACE):
 *
 *   bRequest 0x01  GET_UPTIME       IN,  3-stage,  wLength=8   → k_uptime_get()
 *   bRequest 0x02  SET_LOG_MSG      OUT, 3-stage,  wLength≤32  → log payload
 *   bRequest 0x03  SET_LED_BLINK    OUT, 2-stage,  wLength=0   → count in wValue
 *   bRequest 0x04  STALL_ME         either,        -           → -ENOTSUP → STALL
 *
 * See firmware_sample_usb_04.html §3 for the byte-level Setup packets and §4
 * for the EP0 state machine.
 */

#include <zephyr/kernel.h>
#include <zephyr/usb/usbd.h>
#include <zephyr/usb/usb_ch9.h>
#include <zephyr/sys/byteorder.h>
#include <zephyr/net_buf.h>
#include <zephyr/logging/log.h>
#include <errno.h>

LOG_MODULE_REGISTER(control_demo, LOG_LEVEL_INF);


#define DEMO_CLASS_NAME "control_demo"

/* bRequest values — exposed for the host-side verification scripts in §12. */
#define VREQ_GET_UPTIME       0x01
#define VREQ_SET_LOG_MSG      0x02
#define VREQ_SET_LED_BLINK    0x03
#define VREQ_STALL_ME         0x04

#define LOG_MSG_MAX           32U

/* ===========================================================================
 * Descriptor structs — non-const (G2). iface.iInterface is patched at boot.
 * Identical wire shape to usb_03's strings_demo.
 * =========================================================================*/

static struct usb_if_descriptor iface = {
    .bLength            = sizeof(struct usb_if_descriptor),
    .bDescriptorType    = USB_DESC_INTERFACE,
    .bInterfaceNumber   = 0,                       /* written by stack */
    .bAlternateSetting  = 0,
    .bNumEndpoints      = 2,
    .bInterfaceClass    = USB_BCC_VENDOR,
    .bInterfaceSubClass = 0xFF,
    .bInterfaceProtocol = 0xFF,
    .iInterface         = 0,                       /* patched at boot — G13 */
};

static struct usb_ep_descriptor ep_out = {
    .bLength          = sizeof(struct usb_ep_descriptor),
    .bDescriptorType  = USB_DESC_ENDPOINT,
    .bEndpointAddress = USB_EP_DIR_OUT | 0x01,
    .bmAttributes     = USB_EP_TYPE_BULK,
    .wMaxPacketSize   = sys_cpu_to_le16(64U),
    .bInterval        = 0,
};

static struct usb_ep_descriptor ep_in = {
    .bLength          = sizeof(struct usb_ep_descriptor),
    .bDescriptorType  = USB_DESC_ENDPOINT,
    .bEndpointAddress = USB_EP_DIR_IN  | 0x01,
    .bmAttributes     = USB_EP_TYPE_BULK,
    .wMaxPacketSize   = sys_cpu_to_le16(64U),
    .bInterval        = 0,
};

static struct usb_desc_header *fs_desc[] = {
    (struct usb_desc_header *) &iface,
    (struct usb_desc_header *) &ep_out,
    (struct usb_desc_header *) &ep_in,
    NULL,
};

void control_demo_set_iface_idx(uint8_t idx)
{
    iface.iInterface = idx;
}

/* ===========================================================================
 * Vendor request handlers.
 *
 * Core dispatch (see usbd_ch9.c:976+):
 *   recipient = INTERFACE → routed to the class owning interface wIndex.
 * The class still filters on RequestType.type itself; a recipient=INTERFACE
 * request can be standard / class / vendor, and our class only owns the
 * vendor subset. Anything else → -ENOTSUP (G16).
 *
 * Return-value convention (the one G4 + G16 together encode):
 *   0          → "I handled it." Core completes the transfer normally.
 *   -ENOTSUP   → "Not mine." Core STALLs EP0; host recovers via the usual
 *                CLEAR_FEATURE(ENDPOINT_HALT). This is what VREQ_STALL_ME
 *                returns on purpose.
 *
 * For host-IN requests, fill response bytes into `buf` via net_buf_add_*.
 * The core clamps to MIN(setup->wLength, what we added).
 * =========================================================================*/

static int control_to_host(struct usbd_class_data *const c_data,
                           const struct usb_setup_packet *const setup,
                           struct net_buf *const buf)
{
    ARG_UNUSED(c_data);

    /* G16 — only vendor requests are ours. */
    if (setup->RequestType.type != USB_REQTYPE_TYPE_VENDOR) {
        return -ENOTSUP;
    }

    switch (setup->bRequest) {
    case VREQ_GET_UPTIME: {
        /* 3-stage IN. Host expects 8 bytes; we provide k_uptime_get() in LE.
         * G17 — wLength is host's upper bound. If host requested fewer bytes,
         * the core truncates our 8-byte response. If host requested more, the
         * core appends a ZLP only when our response length is a multiple of
         * the EP0 MPS (64 here) — for an 8-byte payload it never is, so no
         * ZLP needed. */
        if (setup->wLength < sizeof(uint64_t)) {
            LOG_WRN("GET_UPTIME: host wLength=%u < 8 — will truncate",
                    setup->wLength);
        }
        int64_t up = k_uptime_get();
        net_buf_add_le64(buf, (uint64_t)up);
        LOG_INF("GET_UPTIME → %lld ms", (long long)up);
        return 0;
    }

    case VREQ_STALL_ME:
        /* Deliberately refuse. -ENOTSUP propagates → core STALLs EP0. */
        LOG_INF("STALL_ME (IN) → returning -ENOTSUP");
        return -ENOTSUP;

    default:
        LOG_WRN("control_to_host: unknown vendor bRequest 0x%02x",
                setup->bRequest);
        return -ENOTSUP;
    }
}

static int control_to_dev(struct usbd_class_data *const c_data,
                          const struct usb_setup_packet *const setup,
                          const struct net_buf *const buf)
{
    ARG_UNUSED(c_data);

    if (setup->RequestType.type != USB_REQTYPE_TYPE_VENDOR) {
        return -ENOTSUP;
    }

    switch (setup->bRequest) {
    case VREQ_SET_LOG_MSG: {
        /* 3-stage OUT. Host has already sent `setup->wLength` bytes; the core
         * collected them into buf and is calling us to consume. buf->len ==
         * actually-received bytes (could be < wLength if host short-packeted).
         * G18 — clamp to LOG_MSG_MAX to avoid spamming logs with megabytes. */
        size_t n = MIN(buf->len, LOG_MSG_MAX);
        LOG_HEXDUMP_INF(buf->data, n, "SET_LOG_MSG payload:");
        return 0;
    }

    case VREQ_SET_LED_BLINK: {
        /* 2-stage OUT. No DATA stage. Count is in wValue (16-bit).
         * USB allows up to 2 bytes of "data" packed into wValue/wIndex per
         * spec §9.3 — that's the entire point of the 2-stage shape: skip the
         * extra round-trip when payload fits in the Setup packet itself. */
        uint16_t count = setup->wValue;
        LOG_INF("SET_LED_BLINK count=%u (2-stage; no DATA)", count);
        return 0;
    }

    case VREQ_STALL_ME:
        LOG_INF("STALL_ME (OUT) → returning -ENOTSUP");
        return -ENOTSUP;

    default:
        LOG_WRN("control_to_dev: unknown vendor bRequest 0x%02x",
                setup->bRequest);
        return -ENOTSUP;
    }
}

/* ===========================================================================
 * Class API vtable. enable/disable/init carry over from usb_03.
 * =========================================================================*/

static int demo_init(struct usbd_class_data *const c_data)
{
    ARG_UNUSED(c_data);
    LOG_DBG("control_demo: init");
    return 0;
}

static void demo_enable(struct usbd_class_data *const c_data)
{
    ARG_UNUSED(c_data);
    LOG_INF("control_demo: configured (enabled)");
}

static void demo_disable(struct usbd_class_data *const c_data)
{
    ARG_UNUSED(c_data);
    LOG_INF("control_demo: deconfigured (disabled)");
}

static void *demo_get_desc(struct usbd_class_data *const c_data,
                           const enum usbd_speed speed)
{
    ARG_UNUSED(c_data);
    if (speed == USBD_SPEED_FS) {
        return fs_desc;
    }
    return NULL;
}

static const struct usbd_class_api demo_api = {
    .init             = demo_init,
    .enable           = demo_enable,
    .disable          = demo_disable,
    .get_desc         = demo_get_desc,
    .control_to_host  = control_to_host,
    .control_to_dev   = control_to_dev,
};

/* G3 — must match DEMO_CLASS_NAME in main.c. */
USBD_DEFINE_CLASS(control_demo, &demo_api, NULL, NULL);
```
