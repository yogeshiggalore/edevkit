## CMakeLists.txt
```
cmake_minimum_required(VERSION 3.20.0)
find_package(Zephyr REQUIRED HINTS $ENV{ZEPHYR_BASE})
project(led_01)

target_sources(app PRIVATE src/main.c)
```

## prj.conf
```kconfig
#enable gpio configuration
CONFIG_GPIO=y
```

## boards/rpi_pico2_rp2350a_m33.overlay
```dts
/ {
    gpiocustom {
        compatible = "gpio-keys";
        appled0: appled_0 {
            gpios = <&gpio0 25 GPIO_ACTIVE_HIGH>;
            label = "app led 0";
        };
    };

    aliases {
        appled0 = &appled0;
    };
};
```

## src/main.c
```c
/* include kernel components */
#include <zephyr/kernel.h>

/* include device drivers */
#include <zephyr/drivers/gpio.h>

#define LED_SLEEP_TIME_MS   100

/* the device tree indentifier for the appled0 node */
#define LED0_NODE DT_ALIAS(appled0)

/* get devicetree spec for led0 node */
static const struct gpio_dt_spec led = GPIO_DT_SPEC_GET(LED0_NODE, gpios);

int main(void)
{
	int ret;

	/* check if the led port is ready */
	if (!device_is_ready(led.port))
	{
		return -1;
	}

	/* configure the led pin */
	ret = gpio_pin_configure_dt(&led, GPIO_OUTPUT_ACTIVE);
	if (ret < 0)
	{
		return -1;
	}
	/* blink the led */
	while (1)
	{
		/* toggle the led pin */
		gpio_pin_toggle(led.port, led.pin);
		/* sleep for some time */
		k_msleep(LED_SLEEP_TIME_MS);
	}

    return 0;
}
```
